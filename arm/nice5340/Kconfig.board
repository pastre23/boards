## arm/nice5340/Kconfig.board
```kconfig
# Copyright (c) 2024 Nordic Semiconductor ASA
# SPDX-License-Identifier: Apache-2.0

config BOARD_NICE5340
	bool "NiCE5340"
	depends on SOC_NRF5340_CPUAPP_QKAA
```

## arm/nice5340/Kconfig.defconfig
```kconfig
# Copyright (c) 2024 Nordic Semiconductor ASA
# SPDX-License-Identifier: Apache-2.0

if BOARD_NICE5340

config BOARD
	default "nice5340"



endif
```
